## config/west.yml
```yaml
manifest:
  remotes:
    - name: zmkfirmware
      url_base: https://github.com/zmkfirmware
    - name: duckyb
      url_base: https://github.com/duckyb
    - name: petejohanson
      url_base: https://github.com/petejohanson
  projects:
    - name: zmk
      remote: zmkfirmware
      revision: main
      import: app/west.yml
    - name: urchin-zmk-module
      remote: duckyb
      revision: main
    - name: nice-view-gem
      remote: petejohanson
      revision: v1.0.0
  self:
    path: config
```
